## Kconfig
```kconfig
menu "RC522"

    config RC522_PREVENT_SECTOR_TRAILER_WRITE
        bool "Prevent writing to the Sector Trailer block"
        default y
        help
            The Sector Trailer block stores authentication keys
            and access bits. Enabling this option prevents writing
            to the Trailer block. This is enabled by default to protect
            inexperienced users from accidentally overwriting keys or
            writing incorrect access bits, which could render the sector
            unusable.

    config RC522_PICC_SLOT_COUNT
        int "Number of available tag slots for RC522 devices"
        default 2
        range 1 8
        help
            This option sets the number of available tag slots for RC522 devices.
            Each slot can hold one tag. The default value is 2.

endmenu
```
